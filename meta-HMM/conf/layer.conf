## meta-HMM/conf/layer.conf
```bitbake
BBPATH .= ":${LAYERDIR}"
BBFILES += "${LAYERDIR}/recipes-*/*/*.bb"

# append layer name to list of configured layers
BBFILE_COLLECTIONS += "HMM"
# and use name as suffix for other properties
BBFILE_PATTERN_HMM = "^${LAYERDIR}/"
BBFILE_PRIORITY_HMM = "5"

LAYERSERIES_CORENAMES = "bitbakeguilde"

LAYERVERSION_HMM = "1"
LAYERSERIES_COMPAT_HMM = "bitbakeguilde"
```
